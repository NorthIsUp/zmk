
#include <dt-bindings/zmk/kscan_mock.h>

// Three rounds of a four-key roll, 10 ms apart: 24 key events inside 250 ms.
#define ROLL(first_delay)                                                                          \
    ZMK_MOCK_PRESS(0, 0, first_delay) ZMK_MOCK_PRESS(0, 1, 10) ZMK_MOCK_RELEASE(0, 0, 10)          \
        ZMK_MOCK_PRESS(1, 0, 10) ZMK_MOCK_RELEASE(0, 1, 10) ZMK_MOCK_PRESS(1, 1, 10)               \
            ZMK_MOCK_RELEASE(1, 0, 10) ZMK_MOCK_RELEASE(1, 1, 10)

&kscan {
    events = <ZMK_MOCK_RELEASE(0, 0, 5000) ROLL(5000) ROLL(10) ROLL(10)>;
};
