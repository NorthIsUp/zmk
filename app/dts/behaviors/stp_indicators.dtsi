/*
 * Copyright (c) 2026 The ZMK Contributors
 *
 * SPDX-License-Identifier: MIT
 */

/ {
    behaviors {
        stp: behavior_stp_indicators {
            compatible = "zmk,behavior-stp-indicators";
            display-name = "Battery Level";
            #binding-cells = <1>;
        };
    };
};
