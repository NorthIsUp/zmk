## app/dts/bindings/behaviors/zmk,behavior-stp-indicators.yaml
```yaml
# Copyright (c) 2026 The ZMK Contributors
# SPDX-License-Identifier: MIT

description: RGB indicators

compatible: "zmk,behavior-stp-indicators"

include: one_param.yaml
```

## app/module/dts/bindings/test-behaviors/zmk,behavior_dump_metadata.yaml
```yaml
# Copyright (c) 2026 The ZMK Contributors
# SPDX-License-Identifier: MIT

description: Logs behavior metadata and layer names, for tests

compatible: "zmk,behavior-dump-metadata"

include: zero_param.yaml
```

## app/src/split/Kconfig
```kconfig
# Copyright (c) 2022 The ZMK Contributors
# SPDX-License-Identifier: MIT

menuconfig ZMK_SPLIT
    bool "Split keyboard support"

if ZMK_SPLIT

config ZMK_SPLIT_ROLE_CENTRAL
    bool "Split central device"

config ZMK_SPLIT_BLE
    bool "BLE Split"
    default y
    depends on ZMK_BLE
    select BT_USER_PHY_UPDATE
    select BT_AUTO_PHY_UPDATE

config ZMK_SPLIT_WIRED
    bool "Wired Split"
    default y
    depends on DT_HAS_ZMK_WIRED_SPLIT_ENABLED
    select SERIAL
    select RING_BUFFER
    select CRC

config ZMK_SPLIT_PERIPHERAL_HID_INDICATORS
    bool "Peripheral HID Indicators"
    depends on ZMK_HID_INDICATORS
    help
      Enable propagating the HID (LED) Indicator state to the split peripheral(s).

config ZMK_SPLIT_KINESIS_SYNC
    bool "Sync Kinesis underglow and backlight state from central to peripherals"
    default y if ZMK_RGB_UNDERGLOW || ZMK_BACKLIGHT

config ZMK_SPLIT_CENTRAL_KINESIS_LED_QUEUE_SIZE
    int "Queued LED sync commands to peripherals"
    depends on ZMK_SPLIT_ROLE_CENTRAL && ZMK_SPLIT_KINESIS_SYNC
    default 5

config ZMK_SPLIT_CENTRAL_KINESIS_BL_QUEUE_SIZE
    int "Queued backlight sync commands to peripherals"
    depends on ZMK_SPLIT_ROLE_CENTRAL && ZMK_SPLIT_KINESIS_SYNC
    default 5

endif # ZMK_SPLIT

rsource "bluetooth/Kconfig"
rsource "wired/Kconfig"
```
